## drivers/virtio/Kconfig
```kconfig
# SPDX-License-Identifier: Apache-2.0

menuconfig VIRTIO
	bool "VIRTIO drivers"
	help
	  Include interrupt-based inter-processor mailboxes
	  drivers in system configuration

if VIRTIO


config VIRTIO_MMIO
	bool "IPM virtio-mmio driver"
	help
	  Driver for virtio-mmio

module = VIRTIO
module-str = virtio
source "subsys/logging/Kconfig.template.log_config"

endif #IPM
```

## dts/bindings/ipm/virtio-mmio.yaml
```yaml
# Copyright (c) 2019, STMicroelectronics
# SPDX-License-Identifier: Apache-2.0

description: VIRTIO MMIO

compatible: "virtio-mmio"

include: base.yaml

properties:
  device-mode:
    type: boolean
    required: false

  dma-coherent:
    type: boolean
    required: false

  memory-region:
    type: phandle
    required: true
```
